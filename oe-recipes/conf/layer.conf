## oe-recipes/conf/layer.conf
```bitbake
BBPATH .= ":${LAYERDIR}"
BBFILES += "${LAYERDIR}/recipes-*/*/*.bb ${LAYERDIR}/recipes-*/*/*.bbappend"
BBFILE_COLLECTIONS += "onekvm-screen-display"
BBFILE_PATTERN_onekvm-screen-display := "^${LAYERDIR}/"
BBFILE_PRIORITY_onekvm-screen-display = "8"
LAYERDEPENDS_onekvm-screen-display = "core onekvm"
LAYERSERIES_COMPAT_onekvm-screen-display = "wrynose"
```
